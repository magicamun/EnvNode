// EnvNode: see repository LICENSE. Generated; do not edit.
static const SocketContact Weather03Socket[] = {
    {1, "+3V3_DEVKIT", 79.248f, 60.706f},
    {2, "unconnected-(U3-CHIP_PU-Pad2)", 79.248f, 63.246f},
    {3, "ADC3", 79.248f, 65.786f},
    {4, "ADC4", 79.248f, 68.326f},
    {5, "ADC1", 79.248f, 70.866f},
    {6, "ADC2", 79.248f, 73.406f},
    {7, "GPIO32", 79.248f, 75.946f},
    {8, "GPIO33", 79.248f, 78.486f},
    {9, "I2C1_SDA", 79.248f, 81.026f},
    {10, "I2C1_SCL", 79.248f, 83.566f},
    {11, "GPIO27", 79.248f, 86.106f},
    {12, "GPIO14", 79.248f, 88.646f},
    {13, "unconnected-(U3-MTDI{slash}GPIO12{slash}ADC2_CH5-Pad13)", 79.248f, 91.186f},
    {14, "GND", 79.248f, 93.726f},
    {15, "GPIO13", 79.248f, 96.266f},
    {16, "unconnected-(U3-SD_DATA2{slash}GPIO9-Pad16)", 79.248f, 98.806f},
    {17, "unconnected-(U3-SD_DATA3{slash}GPIO10-Pad17)", 79.248f, 101.346f},
    {18, "unconnected-(U3-CMD-Pad18)", 79.248f, 103.886f},
    {19, "+5V", 79.248f, 106.426f},
    {20, "unconnected-(U3-SD_CLK{slash}GPIO6-Pad20)", 104.64432f, 106.42328f},
    {21, "unconnected-(U3-SD_DATA0{slash}GPIO7-Pad21)", 104.64432f, 103.88328f},
    {22, "unconnected-(U3-SD_DATA1{slash}GPIO8-Pad22)", 104.648f, 101.346f},
    {23, "unconnected-(U3-MTDO{slash}GPIO15{slash}ADC2_CH3-Pad23)", 104.648f, 98.806f},
    {24, "unconnected-(U3-ADC2_CH2{slash}GPIO2-Pad24)", 104.648f, 96.266f},
    {25, "unconnected-(U3-GPIO0{slash}BOOT{slash}ADC2_CH1-Pad25)", 104.648f, 93.726f},
    {26, "GPIO4", 104.648f, 91.186f},
    {27, "GPIO16", 104.648f, 88.646f},
    {28, "GPIO17", 104.648f, 86.106f},
    {29, "CS", 104.648f, 83.566f},
    {30, "SCK", 104.648f, 81.026f},
    {31, "MISO", 104.648f, 78.486f},
    {32, "GND", 104.648f, 75.946f},
    {33, "I2C0_SDA", 104.648f, 73.406f},
    {34, "unconnected-(U3-U0RXD{slash}GPIO3-Pad34)", 104.648f, 70.866f},
    {35, "unconnected-(U3-U0TXD{slash}GPIO1-Pad35)", 104.648f, 68.326f},
    {36, "I2C0_SCL", 104.648f, 65.786f},
    {37, "MOSI", 104.648f, 63.246f},
    {38, "GND", 104.648f, 60.706f},
    {39, "Net-(D2-K)", 64.17f, 124.05f},
    {40, "Net-(D1-K)", 66.17f, 124.05f},
};
static const Contact Weather03Contacts0[] = {
    {1, "GND", 120.926f, 55.23f, 689342259200ULL},
    {2, "+5V", 120.926f, 57.23f, 262144ULL},
    {3, "GPIO16", 120.926f, 59.23f, 67108864ULL},
    {4, "+3V3_SYS", 120.926f, 61.23f, 274877906944ULL},
};
static const Contact Weather03Contacts1[] = {
    {1, "GND", 113.16f, 55.23f, 689342259200ULL},
    {2, "+5V", 113.16f, 57.23f, 262144ULL},
    {3, "GPIO14", 113.16f, 59.23f, 2048ULL},
    {4, "+3V3_SYS", 113.16f, 61.23f, 274877906944ULL},
};
static const Contact Weather03Contacts2[] = {
    {1, "GND", 128.692f, 55.23f, 689342259200ULL},
    {2, "+5V", 128.692f, 57.23f, 262144ULL},
    {3, "GPIO17", 128.692f, 59.23f, 134217728ULL},
    {4, "+3V3_SYS", 128.692f, 61.23f, 274877906944ULL},
};
static const Contact Weather03Contacts3[] = {
    {1, "GND", 136.458f, 55.23f, 689342259200ULL},
    {2, "+5V", 136.458f, 57.23f, 262144ULL},
    {3, "GPIO27", 136.458f, 59.23f, 1024ULL},
    {4, "+3V3_SYS", 136.458f, 61.23f, 274877906944ULL},
};
static const Contact Weather03Contacts4[] = {
    {1, "GND", 144.224f, 55.23f, 689342259200ULL},
    {2, "+5V", 144.224f, 57.23f, 262144ULL},
    {3, "GPIO32", 144.224f, 59.23f, 64ULL},
    {4, "+3V3_SYS", 144.224f, 61.23f, 274877906944ULL},
};
static const Contact Weather03Contacts5[] = {
    {1, "GND", 151.99f, 55.23f, 689342259200ULL},
    {2, "+5V", 151.99f, 57.23f, 262144ULL},
    {3, "GPIO4", 151.99f, 59.23f, 33554432ULL},
    {4, "+3V3_SYS", 151.99f, 61.23f, 274877906944ULL},
};
static const Contact Weather03Contacts6[] = {
    {1, "GND", 68.17f, 101.35925f, 689342259200ULL},
    {2, "+5V", 66.17f, 101.35925f, 262144ULL},
    {3, "ADC1", 64.17f, 101.35925f, 16ULL},
    {4, "+3V3_SYS", 62.17f, 101.35925f, 274877906944ULL},
};
static const Contact Weather03Contacts7[] = {
    {1, "GND", 68.17f, 92.60258f, 689342259200ULL},
    {2, "+5V", 66.17f, 92.60258f, 262144ULL},
    {3, "ADC2", 64.17f, 92.60258f, 32ULL},
    {4, "+3V3_SYS", 62.17f, 92.60258f, 274877906944ULL},
};
static const Contact Weather03Contacts8[] = {
    {1, "GND", 68.17f, 83.84592f, 689342259200ULL},
    {2, "+5V", 66.17f, 83.84592f, 262144ULL},
    {3, "ADC3", 64.17f, 83.84592f, 4ULL},
    {4, "+3V3_SYS", 62.17f, 83.84592f, 274877906944ULL},
};
static const Contact Weather03Contacts9[] = {
    {1, "GND", 68.17f, 75.08925f, 689342259200ULL},
    {2, "+5V", 66.17f, 75.08925f, 262144ULL},
    {3, "ADC4", 64.17f, 75.08925f, 8ULL},
    {4, "+3V3_SYS", 62.17f, 75.08925f, 274877906944ULL},
};
static const Contact Weather03Contacts10[] = {
    {1, "GND", 160.23f, 68.78f, 689342259200ULL},
    {2, "+3V3_SYS", 161.23f, 68.78f, 274877906944ULL},
    {3, "I2C0_SDA", 162.23f, 68.78f, 4294967296ULL},
    {4, "I2C0_SCL", 163.23f, 68.78f, 34359738368ULL},
};
static const Contact Weather03Contacts11[] = {
    {1, "GND", 160.23f, 77.11857f, 689342259200ULL},
    {2, "+3V3_SYS", 161.23f, 77.11857f, 274877906944ULL},
    {3, "I2C0_SDA", 162.23f, 77.11857f, 4294967296ULL},
    {4, "I2C0_SCL", 163.23f, 77.11857f, 34359738368ULL},
};
static const Contact Weather03Contacts12[] = {
    {1, "GND", 160.23f, 85.45714f, 689342259200ULL},
    {2, "+3V3_SYS", 161.23f, 85.45714f, 274877906944ULL},
    {3, "I2C0_SDA", 162.23f, 85.45714f, 4294967296ULL},
    {4, "I2C0_SCL", 163.23f, 85.45714f, 34359738368ULL},
};
static const Contact Weather03Contacts13[] = {
    {1, "GND", 160.23f, 93.79571f, 689342259200ULL},
    {2, "+3V3_SYS", 161.23f, 93.79571f, 274877906944ULL},
    {3, "I2C0_SDA", 162.23f, 93.79571f, 4294967296ULL},
    {4, "I2C0_SCL", 163.23f, 93.79571f, 34359738368ULL},
};
static const Contact Weather03Contacts14[] = {
    {1, "GND", 160.23f, 102.13429f, 689342259200ULL},
    {2, "+3V3_SYS", 161.23f, 102.13429f, 274877906944ULL},
    {3, "I2C1_SDA", 162.23f, 102.13429f, 256ULL},
    {4, "I2C1_SCL", 163.23f, 102.13429f, 512ULL},
};
static const Contact Weather03Contacts15[] = {
    {1, "GND", 160.23f, 110.47286f, 689342259200ULL},
    {2, "+3V3_SYS", 161.23f, 110.47286f, 274877906944ULL},
    {3, "I2C1_SDA", 162.23f, 110.47286f, 256ULL},
    {4, "I2C1_SCL", 163.23f, 110.47286f, 512ULL},
};
static const Contact Weather03Contacts16[] = {
    {1, "GND", 160.23f, 118.81143f, 689342259200ULL},
    {2, "+3V3_SYS", 161.23f, 118.81143f, 274877906944ULL},
    {3, "I2C1_SDA", 162.23f, 118.81143f, 256ULL},
    {4, "I2C1_SCL", 163.23f, 118.81143f, 512ULL},
};
static const Contact Weather03Contacts17[] = {
    {1, "GND", 160.23f, 127.15f, 689342259200ULL},
    {2, "+3V3_SYS", 161.23f, 127.15f, 274877906944ULL},
    {3, "I2C1_SDA", 162.23f, 127.15f, 256ULL},
    {4, "I2C1_SCL", 163.23f, 127.15f, 512ULL},
};
static const Contact Weather03Contacts18[] = {
    {1, "GND", 126.69f, 81.19f, 689342259200ULL},
    {2, "+3V3_SYS", 126.69f, 83.73f, 274877906944ULL},
    {3, "GND", 129.23f, 81.19f, 689342259200ULL},
    {4, "+5V", 129.23f, 83.73f, 262144ULL},
    {5, "I2C0_SDA", 131.77f, 81.19f, 4294967296ULL},
    {6, "I2C0_SCL", 131.77f, 83.73f, 34359738368ULL},
    {7, "I2C1_SDA", 134.31f, 81.19f, 256ULL},
    {8, "I2C1_SCL", 134.31f, 83.73f, 512ULL},
    {9, "GPIO33", 136.85f, 81.19f, 128ULL},
    {10, "GPIO13", 136.85f, 83.73f, 16384ULL},
    {11, "MOSI", 139.39f, 81.19f, 68719476736ULL},
    {12, "MISO", 139.39f, 83.73f, 1073741824ULL},
    {13, "SCK", 141.93f, 81.19f, 536870912ULL},
    {14, "CS", 141.93f, 83.73f, 268435456ULL},
};
static const Connector Weather03Connectors[] = {
    {"GPIO16", Pigtail::Gpio, 4, Weather03Contacts0},
    {"GPIO14", Pigtail::Gpio, 4, Weather03Contacts1},
    {"GPIO17", Pigtail::Gpio, 4, Weather03Contacts2},
    {"GPIO27", Pigtail::Gpio, 4, Weather03Contacts3},
    {"GPIO32", Pigtail::Gpio, 4, Weather03Contacts4},
    {"GPIO4", Pigtail::Gpio, 4, Weather03Contacts5},
    {"ADC1", Pigtail::Gpio, 4, Weather03Contacts6},
    {"ADC2", Pigtail::Gpio, 4, Weather03Contacts7},
    {"ADC3", Pigtail::Gpio, 4, Weather03Contacts8},
    {"ADC4", Pigtail::Gpio, 4, Weather03Contacts9},
    {"I2C0_1", Pigtail::I2c, 4, Weather03Contacts10},
    {"I2C0_2", Pigtail::I2c, 4, Weather03Contacts11},
    {"I2C0_3", Pigtail::I2c, 4, Weather03Contacts12},
    {"I2C0_4", Pigtail::I2c, 4, Weather03Contacts13},
    {"I2C1_1", Pigtail::I2c, 4, Weather03Contacts14},
    {"I2C1_2", Pigtail::I2c, 4, Weather03Contacts15},
    {"I2C1_3", Pigtail::I2c, 4, Weather03Contacts16},
    {"I2C1_4", Pigtail::I2c, 4, Weather03Contacts17},
    {"J1", Pigtail::Module, 14, Weather03Contacts18},
};
static const BoardDefinition Weather03Board{"weather-0.3-pcb0.3.0", "EnvNode Weather", "0.3", "0.3.0", Weather03Socket, Weather03Connectors, sizeof(Weather03Connectors) / sizeof(Weather03Connectors[0]), 40};
