// EnvNode: see repository LICENSE. Generated; do not edit.
static const SocketContact MiniSocket[] = {
    {1, "+3V3_DEVKIT", 114.672f, 76.40574f},
    {2, "unconnected-(U3-CHIP_PU-Pad2)", 114.672f, 78.94574f},
    {3, "/ESP32Core/ADC3", 114.672f, 81.48574f},
    {4, "/ESP32Core/ADC4", 114.672f, 84.02574f},
    {5, "/ADC/ADC1", 114.672f, 86.56574f},
    {6, "/ADC/ADC2", 114.672f, 89.10574f},
    {7, "/ESP32Core/GPIO32", 114.672f, 91.64574f},
    {8, "/ESP32Core/GPIO33", 114.672f, 94.18574f},
    {9, "I2C1_SDA", 114.672f, 96.72574f},
    {10, "I2C1_SCL", 114.672f, 99.26574f},
    {11, "/ESP32Core/GPIO27", 114.672f, 101.80574f},
    {12, "/ESP32Core/GPIO14", 114.672f, 104.34574f},
    {13, "unconnected-(U3-MTDI{slash}GPIO12{slash}ADC2_CH5-Pad13)", 114.672f, 106.88574f},
    {14, "GND", 114.672f, 109.42574f},
    {15, "/ESP32Core/GPIO13", 114.672f, 111.96574f},
    {16, "unconnected-(U3-SD_DATA2{slash}GPIO9-Pad16)", 114.672f, 114.50574f},
    {17, "unconnected-(U3-SD_DATA3{slash}GPIO10-Pad17)", 114.672f, 117.04574f},
    {18, "unconnected-(U3-CMD-Pad18)", 114.672f, 119.58574f},
    {19, "+5V", 114.672f, 122.12574f},
    {20, "unconnected-(U3-SD_CLK{slash}GPIO6-Pad20)", 140.06832f, 122.12302f},
    {21, "unconnected-(U3-SD_DATA0{slash}GPIO7-Pad21)", 140.06832f, 119.58302f},
    {22, "unconnected-(U3-SD_DATA1{slash}GPIO8-Pad22)", 140.072f, 117.04574f},
    {23, "unconnected-(U3-MTDO{slash}GPIO15{slash}ADC2_CH3-Pad23)", 140.072f, 114.50574f},
    {24, "unconnected-(U3-ADC2_CH2{slash}GPIO2-Pad24)", 140.072f, 111.96574f},
    {25, "unconnected-(U3-GPIO0{slash}BOOT{slash}ADC2_CH1-Pad25)", 140.072f, 109.42574f},
    {26, "/ESP32Core/GPIO4", 140.072f, 106.88574f},
    {27, "/ESP32Core/GPIO16", 140.072f, 104.34574f},
    {28, "/ESP32Core/GPIO17", 140.072f, 101.80574f},
    {29, "/ESP32Core/CS", 140.072f, 99.26574f},
    {30, "/ESP32Core/SCK", 140.072f, 96.72574f},
    {31, "/ESP32Core/MISO", 140.072f, 94.18574f},
    {32, "GND", 140.072f, 91.64574f},
    {33, "I2C0_SDA", 140.072f, 89.10574f},
    {34, "unconnected-(U3-U0RXD{slash}GPIO3-Pad34)", 140.072f, 86.56574f},
    {35, "unconnected-(U3-U0TXD{slash}GPIO1-Pad35)", 140.072f, 84.02574f},
    {36, "I2C0_SCL", 140.072f, 81.48574f},
    {37, "/ESP32Core/MOSI", 140.072f, 78.94574f},
    {38, "GND", 140.072f, 76.40574f},
};
static const Contact MiniContacts0[] = {
    {1, "GND", 188.51f, 116.332f, 139586445312ULL},
    {2, "+5V", 188.51f, 118.332f, 262144ULL},
    {3, "/ADC/ADC1", 188.51f, 120.332f, 16ULL},
    {4, "+3V3_SYS", 188.51f, 122.332f, 0ULL},
};
static const Contact MiniContacts1[] = {
    {1, "GND", 66.234f, 122.322f, 139586445312ULL},
    {2, "+5V", 66.234f, 120.322f, 262144ULL},
    {3, "/ADC/ADC2", 66.234f, 118.322f, 32ULL},
    {4, "+3V3_SYS", 66.234f, 116.322f, 0ULL},
};
static const Contact MiniContacts2[] = {
    {1, "GND", 186.46f, 87.67f, 139586445312ULL},
    {2, "+3V3_SYS", 187.46f, 87.67f, 0ULL},
    {3, "I2C0_SDA", 188.46f, 87.67f, 4294967296ULL},
    {4, "I2C0_SCL", 189.46f, 87.67f, 34359738368ULL},
};
static const Contact MiniContacts3[] = {
    {1, "GND", 186.46f, 101.147f, 139586445312ULL},
    {2, "+3V3_SYS", 187.46f, 101.147f, 0ULL},
    {3, "I2C0_SDA", 188.46f, 101.147f, 4294967296ULL},
    {4, "I2C0_SCL", 189.46f, 101.147f, 34359738368ULL},
};
static const Contact MiniContacts4[] = {
    {1, "GND", 65.284f, 87.67f, 139586445312ULL},
    {2, "+3V3_SYS", 66.284f, 87.67f, 0ULL},
    {3, "I2C1_SDA", 67.284f, 87.67f, 256ULL},
    {4, "I2C1_SCL", 68.284f, 87.67f, 512ULL},
};
static const Contact MiniContacts5[] = {
    {1, "GND", 65.284f, 101.147f, 139586445312ULL},
    {2, "+3V3_SYS", 66.284f, 101.147f, 0ULL},
    {3, "I2C1_SDA", 67.284f, 101.147f, 256ULL},
    {4, "I2C1_SCL", 68.284f, 101.147f, 512ULL},
};
static const Contact MiniContacts6[] = {
    {1, "GND", 158.428f, 77.47f, 139586445312ULL},
    {2, "+3V3_SYS", 158.428f, 80.01f, 0ULL},
    {3, "EEPROM_A0_A", 160.968f, 77.47f, 139586445312ULL},
    {4, "+5V", 160.968f, 80.01f, 262144ULL},
    {5, "I2C0_SDA", 163.508f, 77.47f, 4294967296ULL},
    {6, "I2C0_SCL", 163.508f, 80.01f, 34359738368ULL},
    {7, "I2C1_SDA", 166.048f, 77.47f, 256ULL},
    {8, "I2C1_SCL", 166.048f, 80.01f, 512ULL},
    {9, "/ESP32Core/GPIO33", 168.588f, 77.47f, 128ULL},
    {10, "/ESP32Core/GPIO13", 168.588f, 80.01f, 16384ULL},
    {11, "/ESP32Core/MOSI", 171.128f, 77.47f, 68719476736ULL},
    {12, "/ESP32Core/MISO", 171.128f, 80.01f, 1073741824ULL},
    {13, "/ESP32Core/SCK", 173.668f, 77.47f, 536870912ULL},
    {14, "/ESP32Core/CS", 173.668f, 80.01f, 268435456ULL},
};
static const Contact MiniContacts7[] = {
    {1, "GND", 81.076f, 77.47f, 139586445312ULL},
    {2, "+3V3_SYS", 81.076f, 80.01f, 0ULL},
    {3, "EEPROM_A0_B", 83.616f, 77.47f, 0ULL},
    {4, "+5V", 83.616f, 80.01f, 262144ULL},
    {5, "I2C0_SDA", 86.156f, 77.47f, 4294967296ULL},
    {6, "I2C0_SCL", 86.156f, 80.01f, 34359738368ULL},
    {7, "I2C1_SDA", 88.696f, 77.47f, 256ULL},
    {8, "I2C1_SCL", 88.696f, 80.01f, 512ULL},
    {9, "/ESP32Core/GPIO32", 91.236f, 77.47f, 64ULL},
    {10, "/ESP32Core/GPIO14", 91.236f, 80.01f, 2048ULL},
    {11, "/ESP32Core/MOSI", 93.776f, 77.47f, 68719476736ULL},
    {12, "/ESP32Core/MISO", 93.776f, 80.01f, 1073741824ULL},
    {13, "/ESP32Core/SCK", 96.316f, 77.47f, 536870912ULL},
    {14, "/ESP32Core/GPIO27", 96.316f, 80.01f, 1024ULL},
};
static const Connector MiniConnectors[] = {
    {"ADC1", Pigtail::Gpio, 4, MiniContacts0},
    {"ADC2", Pigtail::Gpio, 4, MiniContacts1},
    {"J4", Pigtail::I2c, 4, MiniContacts2},
    {"J5", Pigtail::I2c, 4, MiniContacts3},
    {"J6", Pigtail::I2c, 4, MiniContacts4},
    {"J7", Pigtail::I2c, 4, MiniContacts5},
    {"J1", Pigtail::Module, 14, MiniContacts6},
    {"J2", Pigtail::Module, 14, MiniContacts7},
};
static const BoardDefinition MiniBoard{"mini-0.8-pcb0.8.1", "EnvNode Mini", "0.8", "0.8.1", MiniSocket, MiniConnectors, sizeof(MiniConnectors) / sizeof(MiniConnectors[0]), SocketPins};
